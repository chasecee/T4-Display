## sdkconfig.defaults
```kconfig
# Set target
CONFIG_IDF_TARGET="esp32"

# Flash size configuration - Updated to 4MB for T4 V1.3 hardware
CONFIG_ESPTOOLPY_FLASHSIZE_4MB=y
CONFIG_ESPTOOLPY_FLASHSIZE="4MB"

# Custom partition table with SPIFFS support
CONFIG_PARTITION_TABLE_CUSTOM=y
CONFIG_PARTITION_TABLE_CUSTOM_FILENAME="partitions.csv"

# RAM optimizations
CONFIG_SPIRAM=y
CONFIG_SPIRAM_BOOT_INIT=y
CONFIG_SPIRAM_USE_MALLOC=y
CONFIG_SPIRAM_MALLOC_ALWAYSINTERNAL=16384
CONFIG_SPIRAM_MALLOC_RESERVE_INTERNAL=32768

# Performance optimizations
CONFIG_ESP_DEFAULT_CPU_FREQ_MHZ_240=y
CONFIG_COMPILER_OPTIMIZATION_PERF=y
CONFIG_SPI_MASTER_IN_IRAM=y
CONFIG_SPI_MASTER_ISR_IN_IRAM=y
CONFIG_ESP_SPI_BUS_LOCK_ISR_FUNCS_IN_IRAM=y

# JPEG TURBO MODE: External decoder with maximum speed optimizations
CONFIG_JD_USE_ROM=n
CONFIG_JD_FORMAT=1
CONFIG_JD_SZBUF=512
CONFIG_JD_TBLCLIP=y
CONFIG_JD_FASTDECODE_TABLE=y
CONFIG_JD_FASTDECODE=2

# ESP32 Configuration
CONFIG_SPIRAM_SUPPORT=y
CONFIG_SPIRAM_TYPE_AUTO=y
CONFIG_SPIRAM_SPEED_40M=y
CONFIG_SPIRAM_USE_MALLOC=y
CONFIG_SPIRAM_TRY_ALLOCATE_WIFI_LWIP=y
CONFIG_SPIRAM_MALLOC_ALWAYSINTERNAL=16384
CONFIG_SPIRAM_MALLOC_RESERVE_INTERNAL=32768

# Disable sleep modes to avoid issues with PSRAM
CONFIG_PM_ENABLE=n

# Increase buffer sizes for display performance
CONFIG_FREERTOS_HZ=1000
CONFIG_ESP_MAIN_TASK_STACK_SIZE=8192

# LCD Optimizations
CONFIG_LCD_PANEL_IO_FORMAT_BUF_SIZE=32

# SPIFFS settings
CONFIG_SPIFFS_MAX_PARTITIONS=3
CONFIG_SPIFFS_CACHE=y
CONFIG_SPIFFS_CACHE_WR=y
CONFIG_SPIFFS_PAGE_SIZE=256

# Heap settings for PSRAM optimization
CONFIG_HEAP_ABORT_WHEN_ALLOCATION_FAILS=n

# Disable watchdog timers for smooth JPEG playback without interruptions
CONFIG_ESP_TASK_WDT_EN=n
CONFIG_ESP_TASK_WDT_INIT=n 
```
